## modules/lib/gui/awtk/Kconfig.awtk
```kconfig
#
# Copyright (c) 2020 Nordic Semiconductor
#
# SPDX-License-Identifier: LicenseRef-BSD-5-Clause-Nordic
#

menu "AWTK"

config AWTK
	bool "Enable AWTK"

endmenu
```

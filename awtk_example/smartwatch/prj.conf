## CMakeLists.txt
```
#
# Copyright (c) 2020 Nordic Semiconductor
#
# SPDX-License-Identifier: LicenseRef-BSD-5-Clause-Nordic
#

cmake_minimum_required(VERSION 3.13.1)

find_package(Zephyr REQUIRED HINTS $ENV{ZEPHYR_BASE})
project(smartwatch)

zephyr_compile_definitions(HAS_AWTK_CONFIG)
zephyr_compile_definitions(WATCH_ANIMATOR)

zephyr_include_directories(src)
zephyr_include_directories(src/tp)
zephyr_include_directories(src/clock_point_data)
zephyr_include_directories(src/clock_point_data/clock_point_read)
zephyr_include_directories(src/custom_widgets)
zephyr_include_directories(src/custom_widgets/calendar_month)
zephyr_include_directories(src/custom_widgets/color_button)
zephyr_include_directories(src/custom_widgets/gesture)
zephyr_include_directories(src/custom_widgets/music_play_button)
zephyr_include_directories(src/custom_widgets/round_menu)
zephyr_include_directories(src/custom_widgets/watch_clock)
zephyr_include_directories(src/custom_widgets/window_anim_menu)
zephyr_include_directories(src/window_controller)
zephyr_include_directories(src/window_controller/calendar_main)
zephyr_include_directories(src/window_controller/music_main)
zephyr_include_directories(src/window_controller/round_menu_main)
zephyr_include_directories(src/window_controller/training_main)
zephyr_include_directories(src/window_controller/watch_main)
zephyr_include_directories(src/window_controller/weather_main)

FILE(GLOB app_sources
  src/*.c
  src/tp/*.c
  src/clock_point_data/clock_point_read/*.c
  src/custom_widgets/*.c
  src/custom_widgets/calendar_month/*.c
  src/custom_widgets/color_button/*.c
  src/custom_widgets/gesture/*.c
  src/custom_widgets/music_play_button/*.c
  src/custom_widgets/round_menu/*.c
  src/custom_widgets/watch_clock/*.c
  src/custom_widgets/window_anim_menu/*.c
  src/window_controller/*.c
  src/window_controller/calendar_main/*.c
  src/window_controller/music_main/*.c
  src/window_controller/round_menu_main/*.c
  src/window_controller/training_main/*.c
  src/window_controller/watch_main/*.c
  src/window_controller/weather_main/*.c
)

target_sources(app PRIVATE ${app_sources})
```

## sample.yaml
```
sample:
  name: AWTK SmartWatch application
  description: smartwatch
tests:
  sample.display.adafruit_2_8_tft_touch_v2:
    platform_whitelist: nrf52840dk_nrf52840
    extra_args: SHIELD=adafruit_2_8_tft_touch_v2
    tags: shield
```

## prj.conf
```kconfig
#
# Copyright (c) 2020 Nordic Semiconductor
#
# SPDX-License-Identifier: LicenseRef-BSD-5-Clause-Nordic
#
CONFIG_AWTK=y

CONFIG_NEWLIB_LIBC=y

CONFIG_MAIN_STACK_SIZE=32768

CONFIG_DISPLAY=y
CONFIG_ILI9340=y
CONFIG_ILI9340_RGB565=y

CONFIG_SPI=y

CONFIG_I2C=y
```

## src/main.c
```c
/*
 * Copyright (c) 2020 Nordic Semiconductor ASA
 *
 * SPDX-License-Identifier: LicenseRef-BSD-5-Clause-Nordic
 */

#include <zephyr.h>
#include <drivers/display.h>
#include "awtk.h"
#include "assets.h"
#include "awtk_platform.h"

extern ret_t application_init(void);
extern ret_t application_exit(void);

void main(void)
{
	if (platform_init()) {
		return;
	}

	struct device *display_dev = get_display_dev();
	struct display_capabilities cap;

	display_get_capabilities(display_dev, &cap);

	tk_init(cap.x_resolution, cap.y_resolution, APP_MOBILE, NULL, NULL);

	assets_init();

	tk_ext_widgets_init();

	application_init();

	tk_run();

	application_exit();
}
```

## src/assets.c
```c
/*
 * Copyright (c) 2020 Nordic Semiconductor ASA
 *
 * SPDX-License-Identifier: LicenseRef-BSD-5-Clause-Nordic
 */

#include "assets.h"

#include "../res/assets.inc"
```

## src/awtk_config.h
```c
/*
 * Copyright (c) 2020 Nordic Semiconductor ASA
 *
 * SPDX-License-Identifier: LicenseRef-BSD-5-Clause-Nordic
 */

/**
 * File:   awtk_config.h
 * Author: AWTK Develop Team
 * Brief:  config
 *
 * Copyright (c) 2018 - 2019  Guangzhou ZHIYUAN Electronics Co.,Ltd.
 *
 * This program is distributed in the hope that it will be useful,
 * but WITHOUT ANY WARRANTY; without even the implied warranty of
 * MERCHANTABILITY or FITNESS FOR A PARTICULAR PURPOSE.  See the
 * License file for more details.
 *
 */

/**
 * History:
 * ================================================================
 * 2018-09-12 Li XianJing <xianjimli@hotmail.com> created
 *
 */

#ifndef AWTK_CONFIG_H
#define AWTK_CONFIG_H

/**
 * 嵌入式系统有自己的main函数时，请定义本宏。
 *
 */
 #define USE_GUI_MAIN 1

/**
 * 如果需要支持预先解码的位图字体，请定义本宏。一般只在RAM极小时，才启用本宏。
 *
 */
 #define WITH_BITMAP_FONT 1

/**
 * 如果支持png/jpeg图片，请定义本宏
 *
 * #define WITH_STB_IMAGE 1
 */

/**
 * 如果用stb支持Truetype字体，请定义本宏
 *
 * #define WITH_STB_FONT 1
 */

/**
 * 如果用freetype支持Truetype字体，请定义本宏。
 *
 * #define WITH_FT_FONT 1
 */

/**
 * 如果支持从文件系统加载资源，请定义本宏
 *
 * #define WITH_FS_RES 1
 */

/**
 * 如果定义本宏，使用标准的UNICODE换行算法，除非资源极为有限，请定义本宏。
 *
 * #define WITH_UNICODE_BREAK 1
 */

/**
 * 如果定义本宏，将图片解码成BGRA8888格式，否则解码成RGBA8888的格式。
 * 当硬件的2D加速需要BGRA格式时，请启用本宏。
 *
 */
 #define WITH_BITMAP_BGRA 1

/**
 * 如果定义本宏，将不透明的PNG图片解码成BGR565格式，建议定义。
 * 另外和LCD的格式保存一致，可以大幅度提高性能。
 *
 */
 #define WITH_BITMAP_BGR565 1

/**
 * 如果不需输入法，请定义本宏
 *
 */
 #define WITH_NULL_IM 1

/**
 * 如果有标准的malloc/free/calloc等函数，请定义本宏
 *
 * #define HAS_STD_MALLOC 1
 */

/**
 * 如果有标准的fopen/fclose等函数，请定义本宏
 *
 * #define HAS_STDIO 1
 */

/**
 * 如果有标准的pthread等函数，请定义本宏
 *
 * #define HAS_PTHREAD 1
 */

/**
 * 如果有优化版本的memcpy函数，请定义本宏
 *
 */
 #define HAS_FAST_MEMCPY 1

/**
 * 如果出现wcsxxx之类的函数没有定义时，请定义该宏
 *
 */
 #define WITH_WCSXXX 1

/**
 * 如果启用STM32 G2D硬件加速，请定义本宏
 *
 * #define WITH_STM32_G2D 1
 */

/**
 * 如果启用NXP PXP硬件加速，请定义本宏
 *
 * #define WITH_PXP_G2D 1
 */

/**
 * 在没有GPU时，如果启用agge作为nanovg的后端(较agg作为后端：小，快，图形质量稍差)，请定义本宏。
 *
 * #define WITH_NANOVG_AGGE 1
 */

/**
 * 在没有GPU时，如果启用agg作为nanovg的后端(较agge作为后端：大，慢，图形质量好)，请定义本宏。
 * 注意：agg是以GPL协议开源。
 *
 * #define WITH_NANOVG_AGG 1
 */

/**
 * 如果启用鼠标指针，请定义本宏
 *
 * #define ENABLE_CURSOR 1
 */

/**
 * 对于低端平台，如果不使用控件动画，请定义本宏。
 *
 * #define WITHOUT_WIDGET_ANIMATORS 1
 */

/**
 * 对于低端平台，如果不使用窗口动画，请定义本宏。
 *
 * #define WITHOUT_WINDOW_ANIMATORS 1
 */

/**
 * 对于低端平台，如果不使用对话框高亮策略，请定义本宏。
 *
 * #define WITHOUT_DIALOG_HIGHLIGHTER 1
 */

/**
 * 对于低端平台，如果不使用扩展控件，请定义本宏。
 *
 */
 #define WITHOUT_EXT_WIDGETS 1

/**
 * 对于低端平台，如果内存不足以提供完整的FrameBuffer，请定义本宏启用局部FrameBuffer，可大幅度提高渲染性能。
 *
 */
 #define FRAGMENT_FRAME_BUFFER_SIZE 320 * 120

#endif /*AWTK_CONFIG_H*/
```

## src/awtk_date_time.c
```c
/*
 * Copyright (c) 2020 Nordic Semiconductor ASA
 *
 * SPDX-License-Identifier: LicenseRef-BSD-5-Clause-Nordic
 */

#include <zephyr.h>

#include "awtk.h"
#include "awtk_date_time.h"

static ret_t date_time_get_now_impl(date_time_t *dt);
static ret_t date_time_set_now_impl(date_time_t *dt);
static ret_t date_time_from_time_impl(date_time_t *dt, uint64_t timeval);

static const date_time_vtable_t m_date_time_vtable = {
	date_time_get_now_impl,
	date_time_set_now_impl,
	date_time_from_time_impl
};

static const u8_t m_mon_day[12] = {31, 28, 31, 30, 31, 30, 31, 31, 30, 31, 30, 31};

static u64_t m_base_ms;

static date_time_t m_date_cache;
static u64_t m_date_sec_cache;
static u64_t m_sec_cache;

void platform_date_init(void)
{
	date_time_t some_date;

	/* Initiate date to 2020-06-24 12:00:00. */
	some_date.year   = 2020;
	some_date.month  =    6;
	some_date.day    =   24;
	some_date.wday   =    3;
	some_date.hour   =   12;
	some_date.minute =    0;
	some_date.second =    0;
	date_time_set_now_impl(&some_date);

	date_time_global_init_ex(&m_date_time_vtable);
}

static void get_hhmmss_from_sec(date_time_t *dt, uint64_t second)
{
	u64_t timesec;
	u64_t timemin;
	u64_t timehr;

	timesec = second;
	timemin = timesec / 60;
	timehr  = timemin / 60;
	timesec = timesec % 60;
	timemin = timemin % 60;
	timehr  = timehr  % 24;

	dt->second = timesec;
	dt->minute = timemin;
	dt->hour   = timehr;
}

static void get_date_time_from_sec(date_time_t *dt, uint64_t second)
{
	u64_t timeday;
	u64_t timemon;
	u64_t time1yr;
	u64_t time4yr;

	get_hhmmss_from_sec(dt, second);

	timeday = second / (24U * 3600U);
	dt->wday = (6 + timeday) % 7;

	time4yr = timeday / 1461;
	timeday = timeday % 1461;
	time1yr = time4yr * 4;
	if (timeday >= 366) {
		timeday -= 366;
		time1yr++;

		while (timeday >= 365) {
			timeday -= 365;
			time1yr++;
		}
	}
	for (timemon = 0; timemon < 12; timemon++) {
		u8_t mon_day = m_mon_day[timemon];

		if (timemon == 1 && !(time1yr % 4)) {
			/* Febrary of leap year */
			mon_day++;
		}

		if (timeday < mon_day) {
			break;
		} else {
			timeday -= mon_day;
		}
	}

	dt->day    = timeday + 1;
	dt->month  = timemon + 1;
	dt->year   = 2000 + time1yr;
}

static u64_t get_sec_since_yr2000(const date_time_t *dt)
{
	u64_t timesec;
	u64_t timeday;
	u64_t timemon;
	u64_t time1yr;
	u64_t time4yr;
	bool leap_yr;

	timesec  = (u64_t)dt->second;
	timesec += (u64_t)dt->minute * 60U;
	timesec += (u64_t)dt->hour * 3600U;

	/* Calculate the number of days elapsed. */
	time1yr = dt->year - 2000U;
	time4yr = time1yr / 4U;
	time1yr = (time1yr % 4U);
	timeday = time4yr * 1461U;
	if (time1yr > 0) {
		time1yr--;
		timeday += 366U;
		while (time1yr > 0) {
			time1yr--;
			timeday += 365U;
		}
	}
	leap_yr = (!(dt->year % 4));
	for (timemon = 0; timemon < dt->month - 1; timemon++) {
		timeday += m_mon_day[timemon];
		if (timemon == 1 && leap_yr) {
			timeday++;
		}
	}
	timeday += (dt->day - 1);

	timesec += timeday * 24U * 3600U;

	return timesec;
}

static void cache_date_hhmmss(const date_time_t *dt)
{
	m_date_cache.hour   = dt->hour;
	m_date_cache.minute = dt->minute;
	m_date_cache.second = dt->second;
}

static void cache_date_sec(const date_time_t *dt)
{
	m_date_cache.year   = dt->year;
	m_date_cache.month  = dt->month;
	m_date_cache.day    = dt->day;
	m_date_cache.wday   = dt->wday;
	m_date_cache.hour   = 0;
	m_date_cache.minute = 0;
	m_date_cache.second = 0;
	m_date_sec_cache = get_sec_since_yr2000(&m_date_cache);

	cache_date_hhmmss(dt);
}

static ret_t date_time_from_time_impl(date_time_t *dt, uint64_t timeval)
{
	u64_t time_sec = timeval / 1000;

	if (time_sec == m_sec_cache) {
		*dt = m_date_cache;
	} else if (time_sec >= m_date_sec_cache && time_sec < m_date_sec_cache + 24U * 3600U) {
		m_sec_cache = time_sec;
		dt->year  = m_date_cache.year;
		dt->month = m_date_cache.month;
		dt->day   = m_date_cache.day;
		dt->wday  = m_date_cache.wday;
		get_hhmmss_from_sec(dt, time_sec);
		cache_date_hhmmss(dt);
	} else {
		m_sec_cache = time_sec;
		get_date_time_from_sec(dt, time_sec);
		cache_date_sec(dt);
	}

	return RET_OK;
}

static ret_t date_time_get_now_impl(date_time_t *dt)
{
	u64_t now_ms = m_base_ms + get_time_ms64();

	return date_time_from_time_impl(dt, now_ms);
}

static ret_t date_time_set_now_impl(date_time_t *dt)
{
	ret_t err;
	u64_t time_ms;

	if (dt->year < 2000U || dt-> year > 2099U) {
		err = RET_BAD_PARAMS;
	} else {
		m_sec_cache = get_sec_since_yr2000(dt);

		time_ms = m_sec_cache * 1000U;

		m_base_ms = time_ms - get_time_ms64();

		/* a cache to lower runtime load */
		cache_date_sec(dt);

		err = RET_OK;
	}

	return err;
}
```

## src/awtk_date_time.h
```c
/*
 * Copyright (c) 2020 Nordic Semiconductor ASA
 *
 * SPDX-License-Identifier: LicenseRef-BSD-5-Clause-Nordic
 */

#ifndef __AWTK_DATE_TIME_H__
#define __AWTK_DATE_TIME_H__

#include <zephyr.h>

#ifdef __cplusplus
extern "C" {
#endif

void platform_date_init(void);

#ifdef __cplusplus
}
#endif

#endif
```

## src/awtk_display.c
```c
/*
 * Copyright (c) 2020 Nordic Semiconductor ASA
 *
 * SPDX-License-Identifier: LicenseRef-BSD-5-Clause-Nordic
 */

#include <zephyr.h>
#include <device.h>
#include <drivers/display.h>

#include "awtk.h"
#include "awtk_platform.h"
#include "base/pixel.h"
#include "lcd/lcd_mem_fragment.h"

typedef pixel_bgr565_t  pixel_t;
#define LCD_FORMAT      pixel_bgr565_format
#define pixel_bpp	pixel_bgr565_BPP
#define pixel_from_rgb  pixel_bgr565_from_rgb
#define pixel_from_rgba pixel_bgr565_from_rgba
#define pixel_to_rgba   pixel_bgr565_to_rgba

#define lcd_draw_bitmap_impl lcd_draw_bitmap

static void lcd_draw_bitmap(u16_t x, u16_t y, u16_t w, u16_t h, pixel_t *p)
{
	struct device *display_dev;
	struct display_buffer_descriptor buf_desc;

	buf_desc.pitch = w;
	buf_desc.width = w;
	buf_desc.height = h;
	buf_desc.buf_size = w * h * pixel_bpp;

#if LCD_FORMAT == BITMAP_FMT_BGR565
	/* ILI9341 takes a byte swap */
	u32_t i;
	u8_t *ptr = (u8_t*)p;

	for (i = 0; i < w * h; i++)
	{
		u8_t t = *(ptr + i * 2 + 1);

		*(ptr + i * 2 + 1) = *(ptr + i * 2 + 0);
		*(ptr + i * 2 + 0) = t;
	}
#endif

	display_dev = get_display_dev();
	display_write(display_dev, x, y, &buf_desc, (u8_t*)p);
}

#include "blend/pixel_ops.inc"
#include "lcd/lcd_mem_fragment.inc"
```

## src/awtk_mutex.c
```c
/*
 * Copyright (c) 2020 Nordic Semiconductor ASA
 *
 * SPDX-License-Identifier: LicenseRef-BSD-5-Clause-Nordic
 */

#include <zephyr.h>
#include "tkc/mem.h"
#include "tkc/mutex.h"

struct _tk_mutex_t {
	struct k_mutex mutex;
};

tk_mutex_t* tk_mutex_create(void)
{
	tk_mutex_t* mutex;

	mutex = TKMEM_ZALLOC(tk_mutex_t);
	return_value_if_fail(mutex != NULL, NULL);

	int err;

	err = k_mutex_init(&mutex->mutex);
	return (!err) ? mutex : NULL;
}

ret_t tk_mutex_lock(tk_mutex_t* mutex)
{
	return_value_if_fail(mutex != NULL, RET_BAD_PARAMS);

	int err;

	err = k_mutex_lock(&mutex->mutex, K_FOREVER);
	return (!err) ? RET_OK : RET_FAIL;
}

ret_t tk_mutex_unlock(tk_mutex_t* mutex)
{
	return_value_if_fail(mutex != NULL, RET_BAD_PARAMS);

	int err;

	err = k_mutex_unlock(&mutex->mutex);
	return (!err) ? RET_OK : RET_FAIL;
}

ret_t tk_mutex_destroy(tk_mutex_t* mutex)
{
	return_value_if_fail(mutex != NULL, RET_BAD_PARAMS);

	TKMEM_FREE(mutex);

	return RET_OK;
}
```

## src/awtk_platform.c
```c
/*
 * Copyright (c) 2020 Nordic Semiconductor ASA
 *
 * SPDX-License-Identifier: LicenseRef-BSD-5-Clause-Nordic
 */

#include <stdlib.h>
#include <zephyr.h>
#include <device.h>
#include <drivers/display.h>

#include "awtk.h"
#include "awtk_platform.h"
#include "awtk_tp_poll.h"
#include "awtk_date_time.h"
#include "main_loop/main_loop_simple.h"
#include "lcd/lcd_mem_fragment.h"

#ifndef HAS_STD_MALLOC
/* Memory heap dedicated to AWTK. */
static u32_t m_heap_mem[32 * 1024];
#endif

static struct device *m_display_dev;

static void fill_screen(struct device *display_dev, u8_t *p_rgb)
{
	struct display_capabilities cap;
	u8_t *p_buff;

	display_get_capabilities(display_dev, &cap);

#ifndef HAS_STD_MALLOC
	if (sizeof(m_heap_mem) < 2 * cap.x_resolution) {
		return;
	}

	p_buff = (u8_t *)m_heap_mem;
#else
	p_buff = malloc(2 * cap.x_resolution);
#endif
	if (p_buff == NULL) {
		return;
	}

	struct display_buffer_descriptor buf_desc;
	u16_t i;
	u16_t rgb = (*(p_rgb + 2) >> 3) | ((*(p_rgb + 1) >> 2) << 5) | ((*(p_rgb + 0) >> 3) << 11);

	for (i = 0; i < cap.x_resolution; i++) {
		*(p_buff + i * 2 + 0) = (rgb >> 8) & 0xFF;
		*(p_buff + i * 2 + 1) = (rgb     ) & 0xFF;
	}

	buf_desc.pitch = cap.x_resolution;
	buf_desc.width = cap.x_resolution;
	buf_desc.height = 1;
	buf_desc.buf_size = sizeof(2 * cap.x_resolution);

	for (i = 0; i < cap.y_resolution; i++) {
		display_write(display_dev, 0, i, &buf_desc, p_buff);
	}

#ifdef HAS_STD_MALLOC
	free(p_buff);
#endif
}

struct device *get_display_dev(void)
{
	return m_display_dev;
}

int platform_init(void)
{
	m_display_dev = device_get_binding(DT_LABEL(DT_INST(0, ilitek_ili9340)));

	return (m_display_dev != NULL) ? 0 : -ENODEV;
}

ret_t platform_prepare(void)
{
	u8_t rgb[3] = {0x0, 0x0, 0x0};

	display_blanking_on(m_display_dev);

	fill_screen(m_display_dev, rgb);

	display_blanking_off(m_display_dev);

	tp_poll_init();

#ifndef HAS_STD_MALLOC
	tk_mem_init(m_heap_mem, sizeof(m_heap_mem));
#endif

	platform_date_init();

	return RET_OK;
}

static lcd_t *platform_create_lcd(wh_t w, wh_t h)
{
	return lcd_mem_fragment_create(w, h);
}

static ret_t platform_disaptch_input(main_loop_t *l)
{
	static tp_poll_pos_t touch_pos_0;
	tp_poll_pos_t touch_pos;

	while (!tp_poll_get_pos(&touch_pos)) {
		if (touch_pos.z) {
			if (touch_pos.z != touch_pos_0.z ||
			    touch_pos.x != touch_pos_0.x ||
			    touch_pos.y != touch_pos_0.y) {
				main_loop_post_pointer_event(l, TRUE, touch_pos.x, touch_pos.y);
			}
		}
		else if (!touch_pos.z && touch_pos_0.z) {
			main_loop_post_pointer_event(l, FALSE, touch_pos_0.x, touch_pos_0.y);
		}

		touch_pos_0 = touch_pos;
	}

	return RET_OK;
}

#include "main_loop/main_loop_raw.inc"

#include "tkc/fs.h"

fs_t *os_fs(void)
{
	return NULL;
}
```

## src/awtk_platform.h
```c
/*
 * Copyright (c) 2020 Nordic Semiconductor ASA
 *
 * SPDX-License-Identifier: LicenseRef-BSD-5-Clause-Nordic
 */

#ifndef __AWTK_PLATFORM_H__
#define __AWTK_PLATFORM_H__

#include <zephyr.h>

#ifdef __cplusplus
extern "C" {
#endif

int platform_init(void);

struct device *get_display_dev(void);

#ifdef __cplusplus
}
#endif

#endif
```

## src/awtk_tp_poll.c
```c
/*
 * Copyright (c) 2020 Nordic Semiconductor ASA
 *
 * SPDX-License-Identifier: LicenseRef-BSD-5-Clause-Nordic
 */

#include <zephyr.h>
#include <device.h>

#include "awtk.h"
#include "awtk_tp_poll.h"

#define POLL_INTERVAL	K_MSEC(20)

#define POLL_FIFO_CNT	2

typedef struct {
	void *fifo_internal;
	tp_poll_pos_t tp_pos;
} pos_fifo_t;

static pos_fifo_t m_pos_poll[POLL_FIFO_CNT];
static K_FIFO_DEFINE(m_fifo_free);
static K_FIFO_DEFINE(m_fifo_used);

static struct k_delayed_work m_tp_poll;

static void tp_poll_work_fn(struct k_work *work);

void tp_poll_init(void)
{
	u32_t i;

	for (i = 0; i < POLL_FIFO_CNT; i++) {
		k_fifo_put(&m_fifo_free, m_pos_poll + i);
	}

	touch_ft6206_init();

	k_delayed_work_init(&m_tp_poll, tp_poll_work_fn);
	k_delayed_work_submit(&m_tp_poll, POLL_INTERVAL);
}

int tp_poll_get_pos(tp_poll_pos_t *p_pos)
{
	pos_fifo_t *p_fifo;

	p_fifo = k_fifo_get(&m_fifo_used, K_NO_WAIT);

	if (p_fifo != NULL) {
		*p_pos = p_fifo->tp_pos;
		k_fifo_put(&m_fifo_free, p_fifo);
	}
	
	return (p_fifo != NULL) ? 0 : -1;
}

static void tp_poll_work_fn(struct k_work *work)
{
	static tp_poll_pos_t tp_poll_pos_0;
	pos_fifo_t *p_fifo;

	p_fifo = k_fifo_get(&m_fifo_free, K_NO_WAIT);
	if (p_fifo != NULL) {
		touch_pos_t touch_pos = touch_ft6206_get();

		/* Clip the touch panel position to clock face,	which is 240 pixels wide. */
		if (touch_pos.y < 40) {
			touch_pos.y = 40;
		} else if (touch_pos.y > 320 - 40 - 1) {
			touch_pos.y = 320 - 40 - 1;
		}

		/* Map touch panel position to screen position. */
		p_fifo->tp_pos.x = 320 - touch_pos.y;
		p_fifo->tp_pos.y = touch_pos.x;
		p_fifo->tp_pos.z = touch_pos.z;

		if (!p_fifo->tp_pos.z && !tp_poll_pos_0.z) {
			/* Touch panel is idle. Do not report. */
			k_fifo_put(&m_fifo_free, p_fifo);
		} else {
			tp_poll_pos_0 = p_fifo->tp_pos;
			k_fifo_put(&m_fifo_used, p_fifo);
		}
	}

	k_delayed_work_submit(&m_tp_poll, POLL_INTERVAL);
}
```

## src/awtk_tp_poll.h
```c
/*
 * Copyright (c) 2020 Nordic Semiconductor ASA
 *
 * SPDX-License-Identifier: LicenseRef-BSD-5-Clause-Nordic
 */

#ifndef __AWTK_TP_POLL_H__
#define __AWTK_TP_POLL_H__

#include "touch_ft6206.h"

#ifdef __cplusplus
extern "C" {
#endif

typedef touch_pos_t tp_poll_pos_t;

void tp_poll_init(void);

int tp_poll_get_pos(tp_poll_pos_t *p_pos);

#ifdef __cplusplus
}
#endif

#endif
```

## src/wchar.h
```c
/*
 * Copyright (c) 2020 Nordic Semiconductor ASA
 *
 * SPDX-License-Identifier: LicenseRef-BSD-5-Clause-Nordic
 */

#ifndef __WCHAR_H__
#define __WCHAR_H__

#include <stddef.h>

#ifdef __cplusplus
extern "C" {
#endif

size_t wcslen(const wchar_t* s);

int wcscmp(const wchar_t* s1, const wchar_t* s2);

wchar_t* wcscpy(wchar_t* s1, const wchar_t* s2);

wchar_t* wcschr(const wchar_t* s, wchar_t c);

wchar_t* wcsdup(const wchar_t* s);

#ifdef __cplusplus
}
#endif

#endif
```

## src/window_main.c
```c
#include "awtk.h"
#include "custom_widgets/custom_widgets.h"
#include "window_controller/watch_main/watch_main.h"
#include "window_controller/round_menu_main/round_menu_main.h"

static widget_t *gesture_manager = NULL;
static widget_t *window_anim_menu = NULL;

static watch_main_t *watch_main_handle = NULL;
static round_menu_main_t *round_menu_main_handle = NULL;

static ret_t window_main_install_one(void *ctx, const void *iter) {
  widget_t *widget = WIDGET(iter);
  widget_t *win = widget_get_window(widget);
  if (tk_str_eq(widget->vt->type, "window_anim_menu")) {
    window_anim_menu = widget;
  } else if (widget->name != NULL) {
    if (tk_str_eq(widget->name, "gesture_manager")) {
      gesture_manager = widget;
    }
  }

  return RET_OK;
}

static ret_t watch_main_exit_func(struct _controller_base_t *handle,
                                  void *ctx) {
  round_menu_main_set_enable(round_menu_main_handle, TRUE);

  window_anim_menu_play_anim_move_child_for_load(
      handle->window_anim_menu, UI_ROUND_MENU, MENU_ANIMATING_MOVE_TYPE_RIGTH,
      FALSE);

  return RET_OK;
}

static ret_t round_menu_main_exit_func(struct _controller_base_t *handle,
                                       void *ctx) {
  watch_main_set_enable(watch_main_handle, TRUE);

  return RET_OK;
}

/**
 * 初始化
 */
ret_t application_init() {

  custom_widgets_init();

  widget_t *main = window_open("main");

  widget_foreach(main, window_main_install_one, main);

  watch_main_handle = watch_main_init(gesture_manager, window_anim_menu);
  round_menu_main_handle =
      round_menu_main_init(gesture_manager, window_anim_menu);

  return_value_if_fail(watch_main_handle != NULL, RET_OOM);
  return_value_if_fail(round_menu_main_handle != NULL, RET_OOM);

  controller_base_set_exit_func((controller_base_t *)watch_main_handle,
                                watch_main_exit_func, NULL);
  controller_base_set_exit_func((controller_base_t *)round_menu_main_handle,
                                round_menu_main_exit_func, NULL);

  return RET_OK;
}

ret_t application_exit() {
  watch_main_dispose(watch_main_handle);
  round_menu_main_dispose(round_menu_main_handle);
  return RET_OK;
}
```
